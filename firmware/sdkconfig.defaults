## firmware/sdkconfig.defaults
```kconfig
CONFIG_IDF_TARGET="esp32s3"
CONFIG_WIFI_PROV_AUTOSTOP_TIMEOUT=30
CONFIG_COMPILER_CXX_EXCEPTIONS=y

# Increase flash size to 8MB to match final module
CONFIG_ESPTOOLPY_FLASHSIZE_8MB=y

# Use a custom partition table for OTA
CONFIG_PARTITION_TABLE_CUSTOM=y
CONFIG_PARTITION_TABLE_FILENAME="partitions.csv"
CONFIG_PARTITION_TABLE_OFFSET=0x8000
```
